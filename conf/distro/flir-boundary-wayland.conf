## conf/distro/flir-boundary-wayland.conf
```bitbake
# Boundary Distro for Wayland.

require conf/distro/flir-wayland.conf

# Override with boundary settings
PREFERRED_PROVIDER_u-boot = "u-boot-boundary"
PREFERRED_PROVIDER_virtual/kernel = "linux-boundary"
PREFERRED_PROVIDER_virtual/kernel_imx = "linux-boundary"
PREFERRED_VERSION_linux-libc-headers_imx ?= "5.4"


DISTRO = "flir-boundary-wayland"
DISTRO_NAME = "FLIR Boundary Wayland"

IMX_DEFAULT_BSP = "nxp"
```

## conf/distro/flir-framebuffer.conf
```bitbake
require flir-wayland.conf

DISTRO = "flir-framebuffer"
DISTRO_NAME = "FlirSystem Framebuffer"
DISTRO_CODENAME = "hardknott-flir-fb"

# Remove conflicting backends.
DISTRO_FEATURES_remove = "wayland"
```

## conf/distro/flir-wayland.conf
```bitbake
########################################################################
# DISTRO CONFIGURATION
########################################################################
DISTRO = "flir-wayland"
DISTRO_NAME = "FlirSystem Wayland"
DISTRO_VERSION = "3.3.3"
DISTRO_CODENAME = "hardknott-flir-wl"
SDK_VENDOR = "-pokysdk"
SDK_VERSION = "3.3"
SDKPATHINSTALL = "/opt/poky/${SDK_VERSION}"

MAINTAINER = "FLIR System <dev5@flir.se>"

# Additional p4 tool addition - might be solved better?
# HOSTTOOLS_append = " p4"

########################################################################
# DISTRO FEATURE SELECTION
########################################################################

IMAGE_FSTYPES ?= "tar.bz2 ext4"

FLIR_DISTRO_FEATURES = "ipv4 systemd usbhost usbgadget opengl"
FLIR_DISTRO_FEATURES += "wifi bluetooth pulseaudio alsa bluez5"
FLIR_DISTRO_FEATURES += "eabi largefile wayland pam"

DISTRO_FEATURES ?= "${DISTRO_FEATURES_DEFAULT} ${FLIR_DISTRO_FEATURES}"

DISTRO_FEATURES_remove = "x11 directfb pango 3g"
# Do not add in the backfilled distro features listed below
DISTRO_FEATURES_BACKFILL_CONSIDERED = "sysvinit"

SDK_NAME = "${DISTRO}-${TCLIBC}-${SDK_ARCH}-${IMAGE_BASENAME}-${TUNE_PKGARCH}"
SDKPATH = "/opt/poky/${SDK_VERSION}"

#Specifies a suffix to be appended onto the TMPDIR value. 
TCLIBCAPPEND = ""

########################################################################
# LIBRARY NAMES
########################################################################
# Use Debian naming scheme for library (.so) files
INHERIT += "debian"

########################################################################
# PACKING & FEEDS
########################################################################
# Select packaging system
PACKAGE_CLASSES = "package_ipk"

########################################################################
# TOOLCHAIN
########################################################################
LIBC ?= "glibc"

PREFERRED_PROVIDER_hotplug = "udev"

########################################################################
# PREFERRED VERSIONS
########################################################################
VIRTUAL-RUNTIME_init_manager = "systemd"
PREFERRED_PROVIDER_udev ?= "systemd"
PREFERRED_PROVIDER_udev-systemd ?= "systemd"
PREFERRED_PROVIDER_udev-utils ?= "systemd"
#PREFERRED_VERSION_gnupg ?= "2.2.4"

PREFERRED_RPROVIDER_mfgtool-image = "linux-imx-mfgtool"
PREFERRED_RPROVIDER_mfgtool-base = "linux-imx-mfgtool"
PREFERRED_RPROVIDER_mfgtool-image-uimage = "linux-imx-mfgtool"

DEFAULT_TIMEZONE = "Europe/Paris"

# maximum allowed rootfs size in kB
# IMAGE_ROOTFS_MAXSIZE ?= "2500000"
# IMAGE_OVERHEAD_FACTOR = "1"
#leave 10MB free space on rootfs
# IMAGE_ROOTFS_EXTRA_SPACE = "10000"

#use no prefix or we will get conflicting _ in kernel module name
KERNEL_MODULE_PACKAGE_SUFFIX = ""

PREMIRRORS ??= "\
bzr://.*/.*   http://downloads.yoctoproject.org/mirror/sources/ \n \
cvs://.*/.*   http://downloads.yoctoproject.org/mirror/sources/ \n \
git://.*/.*   http://downloads.yoctoproject.org/mirror/sources/ \n \
gitsm://.*/.* http://downloads.yoctoproject.org/mirror/sources/ \n \
hg://.*/.*    http://downloads.yoctoproject.org/mirror/sources/ \n \
osc://.*/.*   http://downloads.yoctoproject.org/mirror/sources/ \n \
p4://.*/.*    http://downloads.yoctoproject.org/mirror/sources/ \n \
svn://.*/.*   http://downloads.yoctoproject.org/mirror/sources/ \n"

MIRRORS =+ "\
ftp://.*/.*      http://downloads.yoctoproject.org/mirror/sources/ \n \
http://.*/.*     http://downloads.yoctoproject.org/mirror/sources/ \n \
https://.*/.*    http://downloads.yoctoproject.org/mirror/sources/ \n"

INHERIT += "own-mirrors"
SOURCE_MIRROR_URL ?= "http://se-arn-dev5/yocto-flirmirror/dl/"


# The CONNECTIVITY_CHECK_URI's are used to test whether we can succesfully
# fetch from the network (and warn you if not). To disable the test set
# the variable to be empty.
# Git example url: git://git.yoctoproject.org/yocto-firewall-test;protocol=git;rev=master

CONNECTIVITY_CHECK_URIS ?= "https://www.example.com/"

SANITY_TESTED_DISTROS ?= " \
            poky-2.7 \n \
            poky-3.0 \n \
            ubuntu-16.04 \n \
            ubuntu-18.04 \n \
            ubuntu-19.04 \n \
            ubuntu-20.04 \n \
            linuxmint-20 \n \
            linuxmint-20.1 \n \
            linuxmint-20.2 \n \
            linuxmint-20.3 \n \
            fedora-28 \n \
            fedora-29 \n \
            fedora-30 \n \
            centos-7 \n \
            debian-8 \n \
            debian-9 \n \
            debian-10 \n \
            opensuseleap-15.1 \n \
            "

#
# OELAYOUT_ABI allows us to notify users when the format of TMPDIR changes in
# an incompatible way. Such changes should usually be detailed in the commit
# that breaks the format and have been previously discussed on the mailing list
# with general agreement from the core team.
#
OELAYOUT_ABI = "12"

# add poky sanity bbclass
INHERIT += "poky-sanity"

# QA check settings - a little stricter than the OE-Core defaults
WARN_TO_ERROR_QA = "already-stripped compile-host-path install-host-path \
                    installed-vs-shipped ldflags pn-overrides rpaths staticdev \
                    useless-rpaths"
WARN_QA_remove = "${WARN_TO_ERROR_QA}"
ERROR_QA_append = " ${WARN_TO_ERROR_QA}"


# Use i.MX Kernel, U-Boot and Gstreamer 1.0 providers
PREFERRED_PROVIDER_virtual/bootloader_imx = "u-boot-imx"
PREFERRED_PROVIDER_virtual/kernel_imx = "linux-imx"
PREFERRED_PROVIDER_u-boot-fw-utils = "u-boot-fw-utils"

# TODO: Migrate to u-boot 2019.04
#PREFERRED_VERSION_u-boot-imx = "2018.03"
#PREFERRED_VERSION_u-boot-fw-utils = "2018.03"

PREFERRED_VERSION_linux-imx-headers ?= "5.10"
PREFERRED_VERSION_linux-libc-headers_imx ?= "5.10"

MACHINE_GSTREAMER_1_0_PLUGIN_mx6ul = "imx-gst1.0-plugin"
MACHINE_GSTREAMER_1_0_PLUGIN_mx6sll = "imx-gst1.0-plugin"
MACHINE_GSTREAMER_1_0_PLUGIN_mx6q = "imx-gst1.0-plugin"
MACHINE_GSTREAMER_1_0_PLUGIN_mx6dl = "imx-gst1.0-plugin"
MACHINE_GSTREAMER_1_0_PLUGIN_mx6sl = "imx-gst1.0-plugin"
MACHINE_GSTREAMER_1_0_PLUGIN_mx6sx = "imx-gst1.0-plugin"
MACHINE_GSTREAMER_1_0_PLUGIN_mx7d = "imx-gst1.0-plugin"
MACHINE_GSTREAMER_1_0_PLUGIN_mx7ulp = "imx-gst1.0-plugin"
MACHINE_GSTREAMER_1_0_PLUGIN_mx8 = "imx-gst1.0-plugin"

# copied from meta-imx/meta-sdk fsl-imx-preferred-env.inc / fsl-imx-base.inc: 
IMX_GPU_VERSION            ?= "6.4.3.p2.4"
IMX_GPU_VERSION_SUFFIX      = "aarch32"
IMX_GPU_VERSION_SUFFIX_mx8  = "aarch64"

REMOVE_VULKAN_FEATURE = "vulkan"

PREFERRED_VERSION_imx-gpu-viv               = "${IMX_GPU_VERSION}-${IMX_GPU_VERSION_SUFFIX}"
PREFERRED_VERSION_kernel-module-imx-gpu-viv = "${IMX_GPU_VERSION}"
PREFERRED_VERSION_imx-gpu-g2d               = "${IMX_GPU_VERSION}"
PREFERRED_VERSION_libgpuperfcnt             = "${IMX_GPU_VERSION}"

PREFERRED_PROVIDER_opencl-headers_imxgpu = "imx-gpu-viv"
PREFERRED_PROVIDER_opencl-icd-loader_imxgpu = "imx-gpu-viv"

PREFERRED_VERSION_gstreamer1.0-plugins-base = "1.18.5.imx"
PREFERRED_VERSION_gstreamer1.0-plugins-bad  = "1.18.5.imx"
PREFERRED_VERSION_gstreamer1.0-plugins-good = "1.18.5.imx"
PREFERRED_VERSION_gstreamer1.0-plugins-good-qt = "1.18.5.imx"
PREFERRED_VERSION_gstreamer1.0-plugins-ugly = "1.18.5"
PREFERRED_VERSION_gstreamer1.0              = "1.18.5.imx"
PREFERRED_VERSION_gstreamer1.0-libav        = "1.18.5"
PREFERRED_VERSION_gstreamer1.0-rtsp-server  = "1.18.5"

PREFERRED_VERSION_imx-gst1.0-plugin     = "4.6.3"

PREFERRED_VERSION_opengl-es-cts_mx6 = "3.2.4.0"
PREFERRED_VERSION_opengl-es-cts_mx7 = "3.2.4.0"

PREFERRED_VERSION_opencv_mx6 = "4.5.2.imx"
PREFERRED_VERSION_opencv_mx7 = "4.5.2.imx"

require conf/distro/include/yocto-uninative.inc
require conf/distro/include/security_flags.inc
INHERIT += "uninative"

MACHINE_EXTRA_RRECOMMENDS_remove = "nxp-wlan-sdk"
MACHINE_FEATURES_remove = "kernel-module-nxp89xx"
```

## conf/distro/flir.conf
```bitbake
########################################################################
# DISTRO CONFIGURATION
########################################################################
DISTRO = "flir"
DISTRO_NAME = "FlirSystem"
DISTRO_VERSION = "${SRCDATE}"
DISTRO_CODENAME = "sumo"
SDK_VENDOR = "-pokysdk"
SDK_VERSION := "2.5"

MAINTAINER = "FLIR System <dev5@flir.se>"

########################################################################
# DISTRO FEATURE SELECTION
########################################################################

IMAGE_FSTYPES = "tar.bz2 ext4 sdcard.bz2"

FLIR_DISTRO_FEATURES = "ipv4 systemd  usbhost usbgadget opengl"
FLIR_DISTRO_FEATURES += "wifi bluetooth pulseaudio alsa bluez5"
FLIR_DISTRO_FEATURES += "eabi largefile wayland pam"

DISTRO_FEATURES ?= "${DISTRO_FEATURES_DEFAULT} ${DISTRO_FEATURES_LIBC} ${FLIR_DISTRO_FEATURES}"

DISTRO_FEATURES_remove = "x11 directfb pango 3g"
# Do not add in the backfilled distro features listed below
DISTRO_FEATURES_BACKFILL_CONSIDERED = "sysvinit"

SDK_NAME = "${DISTRO}-${TCLIBC}-${SDK_ARCH}-${IMAGE_BASENAME}-${TUNE_PKGARCH}"
SDKPATH = "/opt/poky/${SDK_VERSION}"

#Specifies a suffix to be appended onto the TMPDIR value. 
TCLIBCAPPEND = ""

########################################################################
# LIBRARY NAMES
########################################################################
# Use Debian naming scheme for library (.so) files
INHERIT += "debian"


########################################################################
# PACKING & FEEDS
########################################################################
# Select packaging system
PACKAGE_CLASSES = "package_ipk"

########################################################################
# TOOLCHAIN
########################################################################
LIBC ?= "glibc"

PREFERRED_PROVIDER_hotplug = "udev"

########################################################################
# Ensure MACHINE_CLASS is in OVERRIDES
########################################################################
MACHINE_CLASS ?= ""
MACHINE_OVERRIDES += "${MACHINE_CLASS}"

########################################################################
# PREFERRED VERSIONS
########################################################################
VIRTUAL-RUNTIME_init_manager = "systemd"
PREFERRED_PROVIDER_udev ?= "systemd"
PREFERRED_PROVIDER_udev-systemd ?= "systemd"
PREFERRED_PROVIDER_udev-utils ?= "systemd"
#PREFERRED_VERSION_gnupg ?= "2.2.4"

DEFAULT_TIMEZONE = "Europe/Paris"

# maximum allowed rootfs size in kB
# IMAGE_ROOTFS_MAXSIZE ?= "2500000"
# IMAGE_OVERHEAD_FACTOR = "1"
#leave 10MB free space on rootfs
# IMAGE_ROOTFS_EXTRA_SPACE = "10000"

#use no prefix or we will get conflicting _ in kernel module name
KERNEL_MODULE_PACKAGE_SUFFIX = ""

PREMIRRORS ??= "\
bzr://.*/.*   http://downloads.yoctoproject.org/mirror/sources/ \n \
cvs://.*/.*   http://downloads.yoctoproject.org/mirror/sources/ \n \
git://.*/.*   http://downloads.yoctoproject.org/mirror/sources/ \n \
gitsm://.*/.* http://downloads.yoctoproject.org/mirror/sources/ \n \
hg://.*/.*    http://downloads.yoctoproject.org/mirror/sources/ \n \
osc://.*/.*   http://downloads.yoctoproject.org/mirror/sources/ \n \
svn://.*/.*   http://downloads.yoctoproject.org/mirror/sources/ \n"

MIRRORS =+ "\
ftp://.*/.*      http://downloads.yoctoproject.org/mirror/sources/ \n \
http://.*/.*     http://downloads.yoctoproject.org/mirror/sources/ \n \
https://.*/.*    http://downloads.yoctoproject.org/mirror/sources/ \n"

INHERIT += "own-mirrors"
SOURCE_MIRROR_URL ?= "http://se-arn-dev5.zone2.flir.net/yocto-flirmirror/dl/"


# The CONNECTIVITY_CHECK_URI's are used to test whether we can succesfully
# fetch from the network (and warn you if not). To disable the test set
# the variable to be empty.
# Git example url: git://git.yoctoproject.org/yocto-firewall-test;protocol=git;rev=master

CONNECTIVITY_CHECK_URIS ?= "https://www.example.com/"

SANITY_TESTED_DISTROS ?= " \
            poky-2.2 \n \
            poky-2.3 \n \
            poky-2.4 \n \
            ubuntu-12.04 \n \
            ubuntu-15.04 \n \
            ubuntu-16.04 \n \
            ubuntu-16.10 \n \
            ubuntu-17.04 \n \
            ubuntu-18.04 \n \
            fedora-24 \n \
            fedora-25 \n \
            fedora-26 \n \
            centos-7 \n \
            debian-8 \n \
            debian-9 \n \
            opensuse-42.1 \n \
            opensuse-42.2 \n \
            "

# Default hash policy for distro
BB_SIGNATURE_HANDLER ?= 'OEBasicHash'
#
# OELAYOUT_ABI allows us to notify users when the format of TMPDIR changes in
# an incompatible way. Such changes should usually be detailed in the commit
# that breaks the format and have been previously discussed on the mailing list
# with general agreement from the core team.
#
OELAYOUT_ABI = "11"

# add poky sanity bbclass
INHERIT += "poky-sanity"

# QA check settings - a little stricter than the OE-Core defaults
WARN_TO_ERROR_QA = "already-stripped compile-host-path install-host-path \
                    installed-vs-shipped ldflags pn-overrides rpaths staticdev \
                    useless-rpaths"
WARN_QA_remove = "${WARN_TO_ERROR_QA}"
ERROR_QA_append = " ${WARN_TO_ERROR_QA}"


# Use i.MX Kernel, U-Boot and Gstreamer 1.0 providers
PREFERRED_PROVIDER_virtual/bootloader_imx = "u-boot-imx"
PREFERRED_PROVIDER_virtual/kernel_imx = "linux-imx"
PREFERRED_PROVIDER_u-boot-fw-utils = "u-boot-fw-utils"

PREFERRED_VERSION_linux-libc-headers_imx = "4.14"

MACHINE_GSTREAMER_1_0_PLUGIN_mx6ul = "imx-gst1.0-plugin"
MACHINE_GSTREAMER_1_0_PLUGIN_mx6sll = "imx-gst1.0-plugin"
MACHINE_GSTREAMER_1_0_PLUGIN_mx6q = "imx-gst1.0-plugin"
MACHINE_GSTREAMER_1_0_PLUGIN_mx6dl = "imx-gst1.0-plugin"
MACHINE_GSTREAMER_1_0_PLUGIN_mx6sl = "imx-gst1.0-plugin"
MACHINE_GSTREAMER_1_0_PLUGIN_mx6sx = "imx-gst1.0-plugin"
MACHINE_GSTREAMER_1_0_PLUGIN_mx7d = "imx-gst1.0-plugin"
MACHINE_GSTREAMER_1_0_PLUGIN_mx7ulp = "imx-gst1.0-plugin"
MACHINE_GSTREAMER_1_0_PLUGIN_mx8 = "imx-gst1.0-plugin"

# Default toolchains used in testing i.MX BSPs
DEFAULTTUNE_mx6   = "cortexa9hf-neon"
DEFAULTTUNE_mx6ul = "cortexa7hf-neon"
DEFAULTTUNE_mx6sll = "cortexa9hf-neon"
DEFAULTTUNE_mx7d   = "cortexa7hf-neon"
DEFAULTTUNE_mx7ulp = "cortexa7hf-neon"
DEFAULTTUNE_mx8 = "aarch64"

# Enable the kernel loadable module as default
USE_GPU_VIV_MODULE = "1"

# preferred versions of recipes-graphics
PREFERRED_PROVIDER_virtual/libg2d_mx6 = "imx-gpu-g2d"
PREFERRED_PROVIDER_virtual/libg2d_mx7ulp = "imx-gpu-g2d"
PREFERRED_PROVIDER_virtual/egl_mx7ulp = "imx-gpu-viv"
PREFERRED_PROVIDER_virtual/libgles1_mx7ulp = "imx-gpu-viv"
PREFERRED_PROVIDER_virtual/libgles2_mx7ulp = "imx-gpu-viv"
PREFERRED_PROVIDER_virtual/libgl_mx7ulp = "imx-gpu-viv"

PREFERRED_VERSION_openssl                   = "1.0.2p"
PREFERRED_VERSION_openssl-native            = "1.0.2p"


SOC_HAS_VIVANTE_KERNEL_DRIVER_SUPPORT_mx6 = "1"
SOC_HAS_VIVANTE_KERNEL_DRIVER_SUPPORT_mx7ulp = "1"

UBOOT_SUFFIX_mx6ul = "imx"
SPL_BINARY_mx6ul = ""
UBOOT_MAKE_TARGET_mx6ul = "u-boot.imx"

BBMASK += "meta-freescale/recipes-graphics/wayland/weston_%.bbappend"
```
