## conf/layer.conf
```bitbake
# We have a conf and classes directory, add to BBPATH
BBPATH .= ":${LAYERDIR}"

# We have a packages directory, add to BBFILES
BBFILES += "${LAYERDIR}/recipes-*/*/*.bb \
            ${LAYERDIR}/recipes-*/*/*.bbappend"

BBFILE_COLLECTIONS += "flir-base"
BBFILE_PATTERN_flir-base := "^${LAYERDIR}/"
BBFILE_PRIORITY_flir-base = "9"

LAYERSERIES_COMPAT_flir-base = "rocko zeus thud dunfell gatesgarth hardknott"

BB_DANGLINGAPPENDS_WARNONLY = "true"

BBFILES_DYNAMIC += " \
    meta-fsl-bsp-release:${LAYERDIR}/dynamic-layers/meta-fsl-bsp-release/*/*/*.bb \
    meta-fsl-bsp-release:${LAYERDIR}/dynamic-layers/meta-fsl-bsp-release/*/*/*.bbappend \
        \
    freescale-layer:${LAYERDIR}/dynamic-layers/meta-freescale/*/*/*.bb \
    freescale-layer:${LAYERDIR}/dynamic-layers/meta-freescale/*/*/*.bbappend \
        \
    qt5-layer:${LAYERDIR}/dynamic-layers/qt5-layer/*/*/*.bb \
    qt5-layer:${LAYERDIR}/dynamic-layers/qt5-layer/*/*/*.bbappend \
"

# BBMASK += "/meta-fsl-bsp-release/imx/meta-bsp/recipes-security/*"
BBMASK += "/meta-boundary/recipes-connectivity/bluez5/*"

BBMASK += "/meta-flir-base/dynamic-layers/meta-freescale/recipes-bsp/u-boot/u-boot-fw-utils_2018.03.bb"
BBMASK += "/meta-flir-base/dynamic-layers/meta-freescale/recipes-bsp/u-boot/u-boot-manufacturing_2018.03.bb"
BBMASK += "/meta-flir-base/dynamic-layers/meta-freescale/recipes-bsp/u-boot/u-boot-preloaded_2018.03.bb"
BBMASK += "/meta-flir-base/dynamic-layers/meta-freescale/recipes-bsp/u-boot/u-boot-imx_2018.03.bbappend"
```

## conf/machine/bblc.conf
```bitbake
#@TYPE: Machine
#@NAME: FLIR  Entry Level Low Cost Brassboard
#@SOC: i.MX7ULP
#@DESCRIPTION: Machine configuration for FLIR Entry Level Brassboard developed in Sherlock project


MACHINEOVERRIDES =. "mx7:mx7ulp:"

require conf/machine/include/imx-base.inc
require conf/machine/include/tune-cortexa7.inc

MACHINE_FEATURES += "wifi"

KERNEL_DEVICETREE += "imx7ulp-bblc.dtb"

UBOOT_CONFIG ??= "bblc"
UBOOT_CONFIG[bblc] = "mx7ulp_bblc_config"


MACHINE_SOCARCH_SUFFIX = "-mx7ulp"
MACHINE_SOCARCH_FILTER_append_mx7ulp = "virtual/libopenvg virtual/libgles1 virtual/libgles2 virtual/egl virtual/mesa virtual/libgl virtual/libg2d"
IMX_DEFAULT_KERNEL_mx7ulp = "linux-imx"


# Set Serial console
SERIAL_CONSOLES = "115200;ttyLP0"
```

## conf/machine/ec201.conf
```bitbake
#@TYPE: Machine
#@NAME: FLIR  Entry Level Low Cost Board (EC201) Products
#@SOC: i.MX7ULP
#@DESCRIPTION: Machine configuration for FLIR Entry Level Board (EC201) based products.


MACHINEOVERRIDES =. "mx7:mx7ulp:"

require conf/machine/include/imx-base.inc
require conf/machine/include/tune-cortexa7.inc

PREFERRED_PROVIDER_virtual/kernel_ec201 = "linux-pingu"
PREFERRED_VERSION_linux-pingu = "4.14%"
PREFERRED_VERSION_linux-imx-headers = "4.14%"
PREFERRED_VERSION_linux-libc-headers_imx = "4.14%"
PREFERRED_VERSION_nativesdk-linux-libc-headers ?= "4.14%"

MACHINE_EXTRA_RRECOMMENDS_remove = "kernel-module-nxp89xx linux-firmware-nxp89xx"
MACHINE_FEATURES += "wifi bluetooth"

KERNEL_DEVICETREE += "imx7ulp-sherlock.dtb"
KERNEL_DEVICETREE += "imx7ulp-sherlock-a.dtb"
KERNEL_DEVICETREE += "imx7ulp-sherlock-b.dtb"

UBOOT_MACHINE = "mx7ulp_ec201_defconfig"
PREFERRED_PROVIDER_u-boot_ec201 = "u-boot-pingu"
PREFERRED_PROVIDER_virtual/bootloader_ec201 = "u-boot-pingu"
PREFERRED_RPROVIDER_u-boot-default-env = "u-boot-imx-mfgtool"
PREFERRED_PROVIDER_u-boot-default-env = "u-boot-imx-mfgtool"
UBOOT_MAKE_TARGET = "u-boot.imx"

MACHINE_SOCARCH_SUFFIX = "-mx7ulp"
MACHINE_SOCARCH_FILTER_append_mx7ulp = "virtual/libopenvg virtual/libgles1 virtual/libgles2 virtual/egl virtual/mesa virtual/libgl virtual/libg2d"
IMX_DEFAULT_KERNEL_mx7ulp = "linux-imx"

# We want the external galcore module, see fsl-vivante-kernel-driver-handler.bbclass
MACHINE_USES_VIVANTE_KERNEL_DRIVER_MODULE = '1'

# Set Serial console
SERIAL_CONSOLES = "115200;ttyLP0"

IMAGE_FSTYPES = "tar.gz ext4"
```

## conf/machine/ec302.conf
```bitbake
#@TYPE: Machine
#@NAME: FLIR Gunshape Low Cost Board (EC302) Products
#@SOC: i.MX7ULP
#@DESCRIPTION: Machine configuration for FLIR Gunshape low cost Board (EC302) based products.

MACHINEOVERRIDES =. "mx7:mx7ulp:"
require conf/machine/include/imx-base.inc
require conf/machine/include/tune-cortexa7.inc

PREFERRED_PROVIDER_virtual/kernel_ec302 = "linux-pingu"
PREFERRED_VERSION_linux-pingu = "4.14%"
PREFERRED_VERSION_linux-imx-headers = "4.14%"
PREFERRED_VERSION_linux-libc-headers_imx = "4.14%"
PREFERRED_VERSION_nativesdk-linux-libc-headers ?= "4.14%"

KERNEL_DEVICETREE += "imx7ulp-ec302.dtb"

UBOOT_MACHINE = "mx7ulp_ec401w_defconfig"
PREFERRED_PROVIDER_u-boot_ec302 = "u-boot-pingu"
PREFERRED_PROVIDER_virtual/bootloader_ec302 = "u-boot-pingu"
PREFERRED_RPROVIDER_u-boot-default-env = "u-boot-imx-mfgtool"
PREFERRED_PROVIDER_u-boot-default-env = "u-boot-imx-mfgtool"
UBOOT_MAKE_TARGET = "u-boot.imx"

MACHINE_EXTRA_RRECOMMENDS_remove = "kernel-module-nxp89xx linux-firmware-nxp89xx"
MACHINE_FEATURES += "wifi bluetooth"

MACHINE_SOCARCH_SUFFIX = "-mx7ulp"
MACHINE_SOCARCH_FILTER_append_mx7ulp = "virtual/libopenvg virtual/libgles1 virtual/libgles2 virtual/egl virtual/mesa virtual/libgl virtual/libg2d"
IMX_DEFAULT_KERNEL_mx7ulp = "linux-imx"

# We want the external galcore module, see fsl-vivante-kernel-driver-handler.bbclass
MACHINE_USES_VIVANTE_KERNEL_DRIVER_MODULE = '1'

# Set Serial console
SERIAL_CONSOLES = "115200;ttyLP0"

IMAGE_FSTYPES = "tar.gz ext4"
```

## conf/machine/ec401w.conf
```bitbake
#@TYPE: Machine
#@NAME: FLIR One Gen 4
#@SOC: i.MX7ULP
#@DESCRIPTION: Machine configuration for FLIR One Gen 4 based products.

MACHINEOVERRIDES =. "mx7:mx7ulp:"
require conf/machine/include/imx-base.inc
require conf/machine/include/tune-cortexa7.inc

PREFERRED_PROVIDER_virtual/kernel_ec401w = "linux-pingu"
PREFERRED_VERSION_linux-pingu = "4.14%"
PREFERRED_VERSION_linux-imx-headers = "4.14%"
PREFERRED_VERSION_linux-libc-headers_imx = "4.14%"
PREFERRED_VERSION_nativesdk-linux-libc-headers ?= "4.14%"

MACHINE_EXTRA_RRECOMMENDS_remove = "kernel-module-nxp89xx linux-firmware-nxp89xx"
MACHINE_FEATURES += "wifi bluetooth"

KERNEL_DEVICETREE += "imx7ulp-ec401w.dtb"

UBOOT_MACHINE = "mx7ulp_ec401w_defconfig"
PREFERRED_PROVIDER_u-boot_ec401w = "u-boot-pingu"
PREFERRED_PROVIDER_virtual/bootloader_ec401w = "u-boot-pingu"
PREFERRED_RPROVIDER_u-boot-default-env = "u-boot-imx-mfgtool"
PREFERRED_PROVIDER_u-boot-default-env = "u-boot-imx-mfgtool"
UBOOT_MAKE_TARGET = "u-boot.imx"

IMAGE_INSTALL_remove = "packagegroup-flir-gstreamer"
DISTRO_FEATURES_remove = "wayland alsa pulseaudio ipv6"

IMX_DEFAULT_KERNEL_mx7ulp = "linux-imx"

# Set Serial console
SERIAL_CONSOLES = "115200;ttyLP0"

IMAGE_FSTYPES = "tar.gz ext4"

# Packages to use GPLv2
INCOMPATIBLE_LICENSE_bash = "*GPLv3"
INCOMPATIBLE_LICENSE_cpio = "*GPLv3"
INCOMPATIBLE_LICENSE_dosfstools = "*GPLv3"
INCOMPATIBLE_LICENSE_gmp = "*GPLv3"
INCOMPATIBLE_LICENSE_gnutls = "*GPLv3"
INCOMPATIBLE_LICENSE_nettle = "*GPLv3"
INCOMPATIBLE_LICENSE_readline = "*GPLv3"
INCOMPATIBLE_LICENSE_screen = "*GPLv3"

# For some reason INCOMPATIBLE_LICENSE is ignored, so we use PREFERRED_VERSION
PREFERRED_VERSION_bash = "3.2.57"
PREFERRED_VERSION_cpio = "2.8"
PREFERRED_VERSION_dosfstools = "2.11"
PREFERRED_VERSION_gmp = "4.2.1"
PREFERRED_VERSION_gnutls = "3.3.30"
PREFERRED_VERSION_nettle = "2.7.1"
PREFERRED_VERSION_readline = "5.2"
PREFERRED_VERSION_screen = "4.0.3"
```

## conf/machine/ec501.conf
```bitbake
#@TYPE: Machine
#@NAME: Flir Systems Bellatrix Board
#@SOC: i.MX6DL
#@DESCRIPTION: Machine configuration for Flir Systems EC501 Board

# From imx6sabresd-common.inc:
require conf/machine/include/imx-base.inc
require conf/machine/include/tune-cortexa9.inc
SERIAL_CONSOLES = "115200;ttymxc0"

MACHINEOVERRIDES =. "mx6:mx6dl:"

UBOOT_MACHINE = "flir_ec501_config"
PREFERRED_PROVIDER_u-boot_ec501 = "u-boot-pingu"
PREFERRED_PROVIDER_virtual/bootloader_ec501 = "u-boot-pingu"
PREFERRED_RPROVIDER_u-boot-default-env = "u-boot-imx-mfgtool"
PREFERRED_PROVIDER_u-boot-default-env = "u-boot-imx-mfgtool"
UBOOT_MAKE_TARGET = "u-boot.imx"
UBOOT_MAKE_TARGET_pn-u-boot-pingu = "u-boot.imx"

#PREFERRED_PROVIDER_u-boot-fw-utils = "u-boot-fw-utils-pingu"

PREFERRED_PROVIDER_virtual/kernel_ec501 = "linux-pingu"
PREFERRED_VERSION_linux-pingu = "5.10%"

KERNEL_IMAGETYPE = "uImage"

SOC_FAMILY = "mx6:mx6dl"

# Platform u-boot settings
UBOOT_ENTRYPOINT = "0x10800000"
UBOOT_SUFFIX = "imx"

# Firmware
MACHINE_FIRMWARE ?= ""
# FIXME: Uncomment this?
#MACHINE_FIRMWARE_append = " firmware-imx-vpu-imx6q"

MACHINE_EXTRA_RDEPENDS += " \
    e2fsprogs \
    e2fsprogs-mke2fs \
"
MACHINE_EXTRA_RRECOMMENDS += "${MACHINE_FIRMWARE}"
MACHINE_EXTRA_RRECOMMENDS_remove = "kernel-module-nxp89xx linux-firmware-nxp89xx"
MACHINE_FEATURES="apm usbgadget vfat pci wifi rtc"

KERNEL_DEVICETREE = "imx6dl-beco.dtb \
		     imx6dl-blco.dtb \
		     imx6dl-ec501.dtb \
		     imx6dl-detcal.dtb \
		     imx6dl-hawk.dtb \
		     "


# Boot partition size for FAT image generation, 64MiB
BOARD_BOOTIMAGE_PARTITION_SIZE ?= "67108864"

MACHINE_GSTREAMER_PLUGIN = "gst1.0-fsl-plugin"

# This is more product specific than machine specific but...
# FLIR_OPTIONALS = "ipv6"
# Note that you also need ipv6 support in kernel config to enable ipv6 here

# Maybe un-orthodox? Masking in machine conf 

BBMASK .= "|.*meta-digi/"
BBMASK .= "|.*kernel-module-atheros/"
BBFILE_PATTERN_digi-arm = ""
BBFILE_PATTERN_dey = ""
BBFILE_PATTERN_fsl-demos = ""

IMAGE_FSTYPES = "tar.gz ext4"
```

## conf/machine/evco.conf
```bitbake
#@TYPE: Machine
#@NAME: Flir Systems Evander Board
#@SOC: i.MX6DL
#@DESCRIPTION: Machine configuration for Flir Systems EVCO Board

# From imx6sabresd-common.inc:
require conf/machine/include/imx-base.inc
require conf/machine/include/tune-cortexa9.inc
SERIAL_CONSOLES = "115200;ttymxc0"
MACHINE_FIRMWARE_append_mx6 = " linux-firmware-ath6k"
MACHINE_FEATURES += "pci wifi bluetooth"
# removed from sabresd-common's MACHINE_FEATURES:  bcm4339 bcm43455

# For eoco
#MACHINEOVERRIDES =. "mx6:mx6q:mx6dl:"
MACHINEOVERRIDES =. "mx6:mx6dl:"

# FIXME: Switch over to our own u-boot-pingu
UBOOT_MACHINE = "flir_mx6ec101_config"
PREFERRED_PROVIDER_u-boot_evco = "u-boot-pingu"
PREFERRED_PROVIDER_virtual/bootloader_evco = "u-boot-pingu"
PREFERRED_RPROVIDER_u-boot-default-env = "u-boot-imx-mfgtool"
PREFERRED_PROVIDER_u-boot-default-env = "u-boot-imx-mfgtool"
UBOOT_MAKE_TARGET = "u-boot.imx"
UBOOT_MAKE_TARGET_pn-u-boot-pingu = "u-boot.imx"
#UBOOT_SUFFIX_pn-u-boot-pingu = "imx"

#PREFERRED_PROVIDER_u-boot-fw-utils_evco = "u-boot-fw-utils-pingu"

# FIXME: Only while not building our own u-boot-pingu
#UBOOT_MACHINE = "mx6sabresd_config"
#PREFERRED_PROVIDER_u-boot_evco = "u-boot-imx"
#PREFERRED_PROVIDER_virtual/bootloader_evco = "u-boot-imx"
#UBOOT_CONFIG ??= "${@bb.utils.contains('MACHINE_FEATURES', 'optee', 'sd-optee', 'sd', d)}"
#UBOOT_CONFIG[sd] = "mx6qpsabresd_config,sdcard"
#UBOOT_CONFIG[sata] = "mx6qpsabresd_sata_config"
#UBOOT_CONFIG[mfgtool] = "mx6qpsabresd_config"
#UBOOT_CONFIG[sd-optee] = "mx6qpsabresd_optee_config,sdcard"

PREFERRED_PROVIDER_virtual/kernel_evco = "linux-pingu"
PREFERRED_VERSION_linux-pingu = "5.10%"

KERNEL_IMAGETYPE = "uImage"

# Platform u-boot settings
UBOOT_ENTRYPOINT = "0x10800000"
### u-boot-imx settings ###
# The u-boot-imx does not provide unified functionality for DL/Q/QP SoC
# variants. Change the defconfig to the targeted SoC variant.
#SPL_BINARY_pn-u-boot-imx = ""
#UBOOT_MACHINE_pn-u-boot-imx ?= "mx6qsabresd_defconfig"
#UBOOT_MAKE_TARGET_pn-u-boot-imx = "u-boot.imx"
#UBOOT_SUFFIX_pn-u-boot-imx = "imx"
#UBOOT_SUFFIX = "imx"

# Firmware
MACHINE_FIRMWARE ?= ""
# FIXME: Uncomment this?
#MACHINE_FIRMWARE_append = " firmware-imx-vpu-imx6q"

MACHINE_EXTRA_RDEPENDS += " \
    e2fsprogs \
    e2fsprogs-mke2fs \
"
MACHINE_EXTRA_RRECOMMENDS += "${MACHINE_FIRMWARE}"
MACHINE_EXTRA_RRECOMMENDS += "fsl-alsa-plugins"
MACHINE_EXTRA_RRECOMMENDS_remove = "kernel-module-nxp89xx linux-firmware-nxp89xx"

KERNEL_DEVICETREE = "imx6dl-${MACHINE}.dtb \
		     imx6dl-${MACHINE}-db.dtb \
		     imx6dl-${MACHINE}-eb.dtb \
		     imx6dl-${MACHINE}2-ea.dtb \
		     imx6dl-leco-ea.dtb \
		     imx6dl-leco4-ea.dtb \
		     imx6dl-leco.dtb \
		     imx6dl-svco.dtb \
		     imx6dl-detcal.dtb \
		     imx6dl-ninjago.dtb \
		     "

# Boot partition size for FAT image generation, 64MiB
BOARD_BOOTIMAGE_PARTITION_SIZE ?= "67108864"

# For inclusion in packagegroup-flir
MACHINE_GSTREAMER_PLUGIN = "gst1.0-fsl-plugin"

# Maybe un-orthodox? Masking in machine conf 
# When support for digi was added, digi layer should NOT be used
# by other MACHINE than roco. Maybe there is a better way to define
# conditional layers than this??? 
BBMASK .= "|.*meta-digi/"
BBMASK .= "|.*kernel-module-atheros/"
BBFILE_PATTERN_digi-arm = ""
BBFILE_PATTERN_dey = ""
BBFILE_PATTERN_fsl-demos = ""

IMAGE_FSTYPES = "tar.gz ext4"
```

## conf/machine/f1g4.conf
```bitbake
#@TYPE: Machine
#@NAME: FLIR One Gen 4
#@SOC: i.MX7ULP
#@DESCRIPTION: Machine configuration for FLIR One Gen 4 based products.


MACHINEOVERRIDES =. "mx7:mx7ulp:"

require conf/machine/include/imx-base.inc
require conf/machine/include/tune-cortexa7.inc

MACHINE_FEATURES += "wifi bluetooth"

KERNEL_DEVICETREE += "imx7ulp-sherlock.dtb"
KERNEL_DEVICETREE += "imx7ulp-sherlock-a.dtb"
KERNEL_DEVICETREE += "imx7ulp-sherlock-b.dtb"

UBOOT_CONFIG ??= "ec201"
UBOOT_CONFIG[ec201] = "mx7ulp_ec201_config"

MACHINE_SOCARCH_SUFFIX = "-mx7ulp"
MACHINE_SOCARCH_FILTER_append_mx7ulp = "virtual/libopenvg virtual/libgles1 virtual/libgles2 virtual/egl virtual/mesa virtual/libgl virtual/libg2d"
IMX_DEFAULT_KERNEL_mx7ulp = "linux-imx"

# Set Serial console
SERIAL_CONSOLES = "115200;ttyLP0"
```

## conf/machine/rebb.conf
```bitbake
#@TYPE: Machine
#@NAME: FLIR Renata Brass Board (REBB)
#@SOC: i.MX7ULP
#@DESCRIPTION: Machine configuration for FLIR Renata Brass Board (REBB).


MACHINEOVERRIDES =. "mx7:mx7ulp:"

require conf/machine/include/imx-base.inc
require conf/machine/include/tune-cortexa7.inc

PREFERRED_PROVIDER_virtual/kernel_rebb = "linux-pingu"
PREFERRED_VERSION_linux-pingu = "4.14%"

KERNEL_DEVICETREE += "imx7ulp-rebb.dtb"

UBOOT_CONFIG ??= "rebb"
UBOOT_CONFIG[rebb] = "mx7ulp_ec201_config"


MACHINE_SOCARCH_SUFFIX = "-mx7ulp"
MACHINE_SOCARCH_FILTER_append_mx7ulp = "virtual/libopenvg virtual/libgles1 virtual/libgles2 virtual/egl virtual/mesa virtual/libgl virtual/libg2d"
IMX_DEFAULT_KERNEL_mx7ulp = "linux-imx"


# Set Serial console
SERIAL_CONSOLES = "115200;ttyLP0"
```
